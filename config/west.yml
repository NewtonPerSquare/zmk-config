## config/west.yml
```yaml
manifest:
  remotes:
    - name: zmkfirmware
      url-base: https://github.com/zmkfirmware
    - name: newton
      url-base: https://github.com/NewtonPerSquare

  projects:
    - name: zmk
      remote: zmkfirmware
      revision: v0.3.0
      import: app/west.yml

    - name: zmk-nice-oled
      remote: newton
      repo-path: zmk-nice-oled-fix
      revision: main

  self:
    path: config
```
